// time_words.h
// Hebrew time-as-words tables with niqud (vowel marks).
//
// Display rule used by drawTimeInWords():
//   minute  0           -> just HOURS[h]
//   minute  40,45,50,55 -> SUBTRACT_AMOUNT[m] + " " + HOURS_LAMED[next hour]
//   any other minute    -> HOURS[h] + " " + MINUTE_PREFIX[m]
//
// hour index is 0..11 where 0 = 1 o'clock, 11 = 12 o'clock.
//
#pragma once
#include <Arduino.h>

// ── Hour names (regular form) ───────────────────────────────────────
const char* const HOURS[12] = {
  /*  1 */ "אַחַת",
  /*  2 */ "שְׁתַּיִם",
  /*  3 */ "שָׁלוֹשׁ",
  /*  4 */ "אַרְבַּע",
  /*  5 */ "חָמֵשׁ",
  /*  6 */ "שֵׁשׁ",
  /*  7 */ "שֶׁבַע",
  /*  8 */ "שְׁמוֹנֶה",
  /*  9 */ "תֵּשַׁע",
  /* 10 */ "עֶשֶׂר",
  /* 11 */ "אַחַת עֶשְׂרֵה",
  /* 12 */ "שְׁתֵּים עֶשְׂרֵה",
};

// ── Hour names with "ל" prefix (used for ":40 / :45 / :50 / :55") ──
const char* const HOURS_LAMED[12] = {
  /*  1 */ "לְאַחַת",
  /*  2 */ "לִשְׁתַּיִם",
  /*  3 */ "לְשָׁלוֹשׁ",
  /*  4 */ "לְאַרְבַּע",
  /*  5 */ "לְחָמֵשׁ",
  /*  6 */ "לְשֵׁשׁ",
  /*  7 */ "לְשֶׁבַע",
  /*  8 */ "לִשְׁמוֹנֶה",
  /*  9 */ "לְתֵשַׁע",
  /* 10 */ "לְעֶשֶׂר",
  /* 11 */ "לְאַחַת עֶשְׂרֵה",
  /* 12 */ "לִשְׁתֵּים עֶשְׂרֵה",
};

// ── Minute fragment that comes AFTER the hour name ──────────────────
const char* const MINUTE_PREFIX[60] = {
  /* :00 */ "",
  /* :01 */ "וְדַקָּה אַחַת",
  /* :02 */ "וּשְׁתֵּי דַקּוֹת",
  /* :03 */ "וְשָׁלוֹשׁ דַקּוֹת",
  /* :04 */ "וְאַרְבַּע דַקּוֹת",
  /* :05 */ "וְחָמֵשׁ דַקּוֹת",
  /* :06 */ "וְשֵׁשׁ דַקּוֹת",
  /* :07 */ "וְשֶׁבַע דַקּוֹת",
  /* :08 */ "וּשְׁמוֹנֶה דַקּוֹת",
  /* :09 */ "וְתֵשַׁע דַקּוֹת",
  /* :10 */ "וְעֶשֶׂר דַקּוֹת",
  /* :11 */ "וְאַחַת עֶשְׂרֵה דַּקּוֹת",
  /* :12 */ "וּשְׁתֵּים עֶשְׂרֵה דַּקּוֹת",
  /* :13 */ "וּשְׁלוֹשׁ עֶשְׂרֵה דַּקּוֹת",
  /* :14 */ "וְאַרְבַּע עֶשְׂרֵה דַּקּוֹת",
  /* :15 */ "וָרֶבַע",
  /* :16 */ "וְשֵׁשׁ עֶשְׂרֵה דַּקּוֹת",
  /* :17 */ "וּשְׁבַע עֶשְׂרֵה דַּקּוֹת",
  /* :18 */ "וּשְׁמוֹנֶה עֶשְׂרֵה דַּקּוֹת",
  /* :19 */ "וּתְשַׁע עֶשְׂרֵה דַּקּוֹת",
  /* :20 */ "וְעֶשְׂרִים דַקּוֹת",
  /* :21 */ "וְעֶשְׂרִים וְאַחַת",
  /* :22 */ "וְעֶשְׂרִים וּשְׁתַּיִם",
  /* :23 */ "וְעֶשְׂרִים וְשָׁלוֹשׁ",
  /* :24 */ "וְעֶשְׂרִים וְאַרְבַּע",
  /* :25 */ "וְעֶשְׂרִים וְחָמֵשׁ",
  /* :26 */ "וְעֶשְׂרִים וְשֵׁשׁ",
  /* :27 */ "וְעֶשְׂרִים וְשֶׁבַע",
  /* :28 */ "וְעֶשְׂרִים וּשְׁמוֹנֶה",
  /* :29 */ "וְעֶשְׂרִים וְתֵשַׁע",
  /* :30 */ "וָחֵצִי",
  /* :31 */ "שְׁלוֹשִׁים וְאַחַת",
  /* :32 */ "שְׁלוֹשִׁים וּשְׁתַּיִם",
  /* :33 */ "שְׁלוֹשִׁים וְשָׁלוֹשׁ",
  /* :34 */ "שְׁלוֹשִׁים וְאַרְבַּע",
  /* :35 */ "שְׁלוֹשִׁים וְחָמֵשׁ",
  /* :36 */ "שְׁלוֹשִׁים וְשֵׁשׁ",
  /* :37 */ "שְׁלוֹשִׁים וְשֶׁבַע",
  /* :38 */ "שְׁלוֹשִׁים וּשְׁמוֹנֶה",
  /* :39 */ "שְׁלוֹשִׁים וְתֵשַׁע",
  /* :40 */ "",
  /* :41 */ "אַרְבָּעִים וְאַחַת",
  /* :42 */ "אַרְבָּעִים וּשְׁתַּיִם",
  /* :43 */ "אַרְבָּעִים וְשָׁלוֹשׁ",
  /* :44 */ "אַרְבָּעִים וְאַרְבַּע",
  /* :45 */ "",
  /* :46 */ "אַרְבָּעִים וְשֵׁשׁ",
  /* :47 */ "אַרְבָּעִים וְשֶׁבַע",
  /* :48 */ "אַרְבָּעִים וּשְׁמוֹנֶה",
  /* :49 */ "אַרְבָּעִים וְתֵשַׁע",
  /* :50 */ "",
  /* :51 */ "חֲמִשִּׁים וְאַחַת",
  /* :52 */ "חֲמִשִּׁים וּשְׁתַּיִם",
  /* :53 */ "חֲמִשִּׁים וְשָׁלוֹשׁ",
  /* :54 */ "חֲמִשִּׁים וְאַרְבַּע",
  /* :55 */ "",
  /* :56 */ "חֲמִשִּׁים וְשֵׁשׁ",
  /* :57 */ "חֲמִשִּׁים וְשֶׁבַע",
  /* :58 */ "חֲמִשִּׁים וּשְׁמוֹנֶה",
  /* :59 */ "חֲמִשִּׁים וְתֵשַׁע",
};

// ── "X-minutes-to" amount, used only for :40 / :45 / :50 / :55 ─────
const char* const SUBTRACT_AMOUNT[60] = {
  /* 0..39 unused */ "","","","","","","","","","","","","","","","","","","","",
                     "","","","","","","","","","","","","","","","","","","","",
  /* :40 */ "עֶשְׂרִים",
  /* :41 */ "", /* :42 */ "", /* :43 */ "", /* :44 */ "",
  /* :45 */ "רֶבַע",
  /* :46 */ "", /* :47 */ "", /* :48 */ "", /* :49 */ "",
  /* :50 */ "עֲשָׂרָה",
  /* :51 */ "", /* :52 */ "", /* :53 */ "", /* :54 */ "",
  /* :55 */ "חֲמִשָּׁה",
  /* :56 */ "", /* :57 */ "", /* :58 */ "", /* :59 */ "",
};

inline bool isSubtractMinute(int m) {
  return m == 40 || m == 45 || m == 50 || m == 55;
}

// ── Time-of-day period ─────────────────────────────────────────────────
inline const char* getTimePeriod(int hour24) {
  if (hour24 >= 6 && hour24 < 12)  return "בַּבֹּקֶר";
  if (hour24 >= 12 && hour24 < 18) return "בַּצָּהֳרַיִם";
  if (hour24 >= 18 && hour24 < 24) return "בָּעֶרֶב";
  if (hour24 >= 0 && hour24 < 4)   return "בַּלַּיְלָה";
  /* 4..5 */                        return "לִפְנוֹת בֹּקֶר";
}
